## drivers/media/video/msm/Kconfig
```kconfig
config MSM_CAMERA_V4L2
        bool "MSM Camera V4L2 Interface"
        depends on MSM_CAMERA
        default n
        ---help---
          This flag enables V4L2 interface of MSM
          camera driver. If enabled, application interacts
          with /dev/video0 through V4L2 APIs. Otherwise,
          native APIs are used through /dev/config0, /dev/frame0,
          and /dev/control0.

comment "Camera Sensor Selection"
config MT9T013
	bool "Sensor mt9t013 (BAYER 3M)"
	depends on MSM_CAMERA && !ARCH_MSM8X60 && !MSM_CAMERA_V4L2
	default y
	---help---
	  MICRON 3M Bayer Sensor with AutoFocus

config MT9D112
	bool "Sensor mt9d112 (YUV 2M)"
	depends on MSM_CAMERA && !ARCH_MSM8X60 && !MSM_CAMERA_V4L2
	default y
	---help---
	  MICRON 2M YUV Sensor
config IMX074
	bool "Sensor IMX074 (BAYER 13.5M)"
	depends on MSM_CAMERA && ARCH_MSM8X60 && !MSM_CAMERA_V4L2
	default y
	---help---
	SONY 13.5 MP Bayer Sensor
config WEBCAM_OV7692
	bool "Sensor OV7692 (VGA YUV)"
	depends on MSM_CAMERA && ARCH_MSM8X60 && !MSM_CAMERA_V4L2
	default y
	---help---
	  Omni Vision VGA YUV Sensor.
#	This Senosr is used as a webcam.
#	This uses the CSI interface.
#	Need to enable CSI1 clks for this sensor.
config VX6953
	bool "Sensor VX6953 (BAYER 5M)"
	depends on MSM_CAMERA && ARCH_MSM7X30
	default y
	---help---
	STM 5M Bayer Sensor with EDOF
config SN12M0PZ
	bool "Sensor sn12m0pz (Bayer 12 MP)"
	depends on MSM_CAMERA && ARCH_MSM7X30 && !MSM_CAMERA_V4L2
	default y
	---help---
	  Sony 12 MP Bayer Sensor
config MT9P012
	bool "Sensor mt9p012 (BAYER 5M)"
	depends on MSM_CAMERA && !ARCH_MSM8X60 && !MSM_CAMERA_V4L2
	default y
	---help---
	  MICRON 5M Bayer Sensor with Autofocus

config MT9V113
	bool "Sensor mt9v113 (YUV 0.3M)"
	depends on MSM_CAMERA && !ARCH_MSM8X60
	default n
	---help---
	  APTINA 0.3M YUV Sensor

config MT9P111
	bool "Sensor mt9p111 (YUV 5.0M)"
	depends on MSM_CAMERA && !ARCH_MSM8X60
	default n
	---help---
	  APTINA 5.0M YUV Sensor

if MT9P111
config MT9P111_MCNEX
	bool "Sensor mt9p111 (YUV 5.0M), Module MCNEX"
	depends on MSM_CAMERA && MT9P111
	default n
	---help---
	  APTINA 5.0M YUV Sensor, Module MCNEX

config MT9P111_SAMSUNG_FPC
	bool "Sensor mt9p111 (YUV 5.0M) of FPC, Module SAMSUNG"
	depends on MSM_CAMERA && MT9P111
	default n
	---help---
	  APTINA 5.0M YUV Sensor, Module SAMSUNG

config MT9P111_SAMSUNG_SOCKET
	bool "Sensor mt9p111 (YUV 5.0M) of socket, Module SAMSUNG"
	depends on MSM_CAMERA && MT9P111
	default y
	---help---
	  APTINA 5.0M YUV Sensor, Module SAMSUNG
endif # MT9P111
	  
config MT9T11X
	bool "Sensor mt9t111 or mt9t112 (YUV 3.1M)"
	depends on MSM_CAMERA && !ARCH_MSM8X60
	default y
	---help---
	  APTINA 3.1M YUV Sensor

if MT9T11X
config MT9T11X_QTECH_MCNEX_FPC
	bool "Sensor mt9t111 or mt9t112 (YUV 3.1M) of FPC, Module QTECHGLOBAL or MCNEX"
	depends on MSM_CAMERA
	default y
	---help---
	  APTINA 3.1M YUV Sensor

config MT9T11X_QTECH_MCNEX_SOCKET
	bool "Sensor mt9t111 or mt9t112 (YUV 3.1M) of socket, Module QTECHGLOBAL or MCNEX"
	depends on MSM_CAMERA
	default n
	---help---
	  APTINA 3.1M YUV Sensor
endif # MT9T11X

config OV5642
	bool "Sensor ov5642 (YUV 5.0M)"
	depends on MSM_CAMERA && !ARCH_MSM8X60
	default n
	---help---
	  OmniVision 5.0M YUV Sensor

if OV5642
config OV5642_GLOBALOPTICS
	bool "Sensor ov5642 (YUV 5.0M), Module GLOBALOPTICS"
	depends on MSM_CAMERA
	default y
	---help---
	  OmniVision 5.0M YUV Sensor, Module GLOBALOPTICS
endif # OV5642
config OV5640
	bool "Sensor ov5640 (YUV 5.0M)"
	depends on MSM_CAMERA && !ARCH_MSM8X60
	default n
	---help---
	  OmniVision 5.0M YUV Sensor

if OV5640
config OV5640_GLOBALOPTICS
	bool "Sensor ov5640 (YUV 5.0M), Module GLOBALOPTICS"
	depends on MSM_CAMERA
	default y
	---help---
	  OmniVision 5.0M YUV Sensor, Module GLOBALOPTICS
endif # OV5640

config HI704
	bool "Sensor hi704(YUV 0.3M)"
	depends on MSM_CAMERA
	default n
	---help---
	  Hynix 0.3M YUV Sensor

if HI704
config HI704_KERR
	bool "Sensor hi704 (YUV 0.3M), Module KERR"
	depends on MSM_CAMERA
	default y
	---help---
	  Hynix 5.0M YUV Sensor, Module KERR
endif # HI704

config MT9D115
	bool "Sensor mt9d115(YUV 2.0M)"
	depends on MSM_CAMERA && !ARCH_MSM8X60
	default n
	---help---
	  APTINA 2.0M YUV sensor

if MT9D115
config MT9D115_QTECH_SUNNY_SOCKET
	bool "Sensor mt9d115 (YUV 2.0M) of socket, Module QTECH or SUNNYOPTICAL"
	depends on MSM_CAMERA
	default y
	---help---
	  APTINA 2.0M YUV Sensor, Module QTECH or SUNNYOPTICAL

config MT9D115_QTECH_SUNNY_FPC
	bool "Sensor mt9d115 (YUV 2.0M) of FPC, Module QTECH or SUNNYOPTICAL"
	depends on MSM_CAMERA
	default n
	---help---
	  APTINA 2.0M YUV Sensor, Module QTECH or SUNNYOPTICAL
endif # MT9D115

config MT9D113
	bool "Sensor mt9d113(YUV 2.0M)"
	depends on MSM_CAMERA && !ARCH_MSM8X60
	default n
	---help---
	  APTINA 2.0M YUV sensor

if MT9D113
config MT9D113_QTECH_SUNNY_SOCKET
	bool "Sensor mt9d113 (YUV 2.0M) of socket, Module QTECH or SUNNYOPTICAL"
	depends on MSM_CAMERA
	default y
	---help---
	  APTINA 2.0M YUV Sensor, Module QTECH or SUNNYOPTICAL
endif # MT9D113
choice
	prompt "AF module"
	depends on MT9P012 && !ARCH_MSM8X60 && !MSM_CAMERA_V4L2
	default MSM_CAMERA_AF_FOXCONN

config MSM_CAMERA_AF_FOXCONN
	bool "FOXCONN Module"
	help
	  This driver supports FOXCONN AF module for 5M Bayer sensor

config MSM_CAMERA_AF_BAM
	bool "BAM Module"
	help
	  This driver supports BAM AF module for 5M Bayer sensor

endchoice

config MT9P012_KM
	bool "Sensor mt9p012 KM module (BAYER 5M)"
	depends on MSM_CAMERA && !ARCH_MSM8X60 && !MSM_CAMERA_V4L2
	default y
	---help---
	  MICRON 5M Bayer Sensor KM modules with Autofocus

config MT9E013
	bool "Sensor mt9e013 module (BAYER 8M)"
	depends on MSM_CAMERA && ARCH_MSM7X30 && !MSM_CAMERA_V4L2
	default y
	---help---
	  Aptina 8M Bayer Sensor modules with Autofocus

config S5K3E2FX
	bool "Sensor s5k3e2fx (Samsung 5M)"
	depends on MSM_CAMERA && !ARCH_MSM8X60 && !MSM_CAMERA_V4L2
	default y
	---help---
	  Samsung 5M with Autofocus

config VB6801
	bool "Sensor vb6801"
	depends on MSM_CAMERA && !ARCH_MSM8X60 && !MSM_CAMERA_V4L2
	---help---
	  5M with flash

config SENSOR_ADAPTER
	bool "Adapter for different sensors"
	depends on MSM_CAMERA && !ARCH_MSM8X60
	default n
	---help---
	  Adapter for ov5642 and mt9t11x

config SENSOR_INFO
	bool "Get sensor info through EM"
	depends on MSM_CAMERA && !ARCH_MSM8X60
	default y
	---help---
	  Get sensor id and name through EM (Engineering Mode)
config MSM_CAMERA_FLASH
	bool "Qualcomm MSM camera flash support"
	depends on MSM_CAMERA
	default y
	---help---
	  Enable support for LED flash for msm camera

config MSM_GEMINI
	tristate "Qualcomm MSM Gemini Jpeg Engine support"
	depends on MSM_CAMERA && (ARCH_MSM7X30 || ARCH_MSM8X60)
	default M
	---help---
	  Enable support for Gemini Jpeg Engine

config MSM_VPE
	tristate "Qualcomm MSM Video Pre-processing Engine support"
	depends on MSM_CAMERA && (ARCH_MSM7X30 || ARCH_MSM8X60)
	default y
	---help---
	  Enable support for Video Pre-processing Engine

config QUP_EXCLUSIVE_TO_CAMERA
	bool "QUP exclusive to camera"
	depends on MSM_CAMERA
	default y
	---help---
	  This flag enabled states that QUP
	  is exclusive to camera. In case this
	  is disabled, the lvs1 voltage is enabled
	  by QUP in the board file as QUP is used by
	  applications other than camera.
```

## drivers/media/video/nmi326/Kconfig
```kconfig
#
# Configuration for nmi_hw (ISDB-T)
#

config ZTE_DTV
	bool "MSM8255 ISDB-T NMI Driver" 
	default n
	---help---
	  This is a ISDB-T for NMI Driver.

config ISDBT_NMI_DEBUG
	bool "print ISDB-T NMI debug message"
	depends on ZTE_DTV
	default n
```

## drivers/misc/mpu3050/Kconfig
```kconfig
### ZTE_MODIFY zhaoy0001:added by zhaoyang 2011/05/21 for adding MPU3050 gyro driver
menu "Motion Sensors Support"

choice
    tristate "Motion Processing Unit"
    depends on I2C
    default MPU_NONE

config MPU_NONE
    bool "None"
    help
      This disables support for motion processing using the MPU family of 
      motion processing units.

config GYRO_MPU3050_ZTE
    tristate "MPU3050"
    depends on I2C
    help
      If you say yes here you get support for the MPU3050 Gyroscope driver
      This driver can also be built as a module.  If so, the module
      will be called mpu3050.

config MPU_SENSORS_MPU6000
    tristate "MPU6000"
    depends on I2C
    help
      If you say yes here you get support for the MPU6000 Gyroscope driver
      This driver can also be built as a module.  If so, the module
      will be called mpu6000.

endchoice

choice
    prompt "Accelerometer Type"
    depends on GYRO_MPU3050_ZTE
    default MPU_SENSORS_BMA150

config MPU_SENSORS_ACCELEROMETER_NONE
    bool "NONE"
    depends on GYRO_MPU3050_ZTE || MPU_SENSORS_MPU6000
    help
      This disables accelerometer support for the MPU3050

config MPU_SENSORS_ADXL346
    bool "ADI adxl346"
    depends on GYRO_MPU3050_ZTE
    help
      This enables support for the ADI adxl346 accelerometer

config MPU_SENSORS_BMA150
    bool "Bosch BMA150"
    depends on GYRO_MPU3050_ZTE
    help
      This enables support for the Bosch BMA150 accelerometer
 
config MPU_SENSORS_BMA222
    bool "Bosch BMA222"
    depends on GYRO_MPU3050_ZTE
    help
      This enables support for the Bosch BMA222 accelerometer
      
config MPU_SENSORS_KXSD9
    bool "Kionix KXSD9"
    depends on GYRO_MPU3050_ZTE
    help
      This enables support for the Kionix KXSD9 accelerometer

config MPU_SENSORS_LIS331DLH
    bool "ST lis331dlh"
    depends on GYRO_MPU3050_ZTE
    help
      This enables support for the ST lis331dlh accelerometer
      
### ZTE_MODIFY zhaoy0030 modify gyroscope driver to support kxtik accelerometer 2011/08/25
config MPU_KXTF9_or_MPU_MMA845X_or_MPU_LIS3DH
    bool "Kionix KXTF9 or Freescale mma8451/8452/8453 or ST lis3dh"
    depends on GYRO_MPU3050_ZTE
    help
      This enables support for the Kionix KXFT9 accelerometer or the Freescale mma8451/8452/8453 accelerometer or the ST lis3dh accelerometer 
## ZTE_MODIFY end ##

config MPU_SENSORS_LSM303DLHA
    bool "ST lsm303dlh"
    depends on GYRO_MPU3050_ZTE
    help
      This enables support for the ST lsm303dlh accelerometer

config MPU_SENSORS_MMA8450
    bool "Freescale mma8450"
    depends on GYRO_MPU3050_ZTE
    help
      This enables support for the Freescale mma8450 accelerometer

endchoice

choice
    prompt "Compass Type"
    depends on MPU_SENSORS_MPU6000 || GYRO_MPU3050_ZTE
    default MPU_SENSORS_AK8975

config MPU_SENSORS_COMPASS_NONE
    bool "NONE"
    depends on MPU_SENSORS_MPU6000 || GYRO_MPU3050_ZTE
    help
      This disables compass support for the MPU6000

config MPU_SENSORS_AK8975
    bool "AKM ak8975"
    depends on MPU_SENSORS_MPU6000 || GYRO_MPU3050_ZTE
    help
      This enables support for the AKM ak8975 compass

config MPU_SENSORS_MMC314X
    bool "MEMSIC mmc314x"
    depends on GYRO_MPU3050_ZTE
    help
      This enables support for the MEMSIC mmc314x compass

config MPU_SENSORS_AMI30X
    bool "Aichi Steel ami30X"
    depends on GYRO_MPU3050_ZTE
    help
      This enables support for the Aichi Steel ami304/ami305 compass

config MPU_SENSORS_AMI306
    bool "Aichi Steel ami306"
    depends on GYRO_MPU3050_ZTE
    help
      This enables support for the Aichi Steel ami306 compass

config MPU_SENSORS_HMC5883
    bool "Honeywell hmc5883"
    depends on GYRO_MPU3050_ZTE
    help
      This enables support for the Honeywell hmc5883 compass

config MPU_SENSORS_LSM303DLHM
    bool "ST lsm303dlh"
    depends on GYRO_MPU3050_ZTE
    help
      This enables support for the ST lsm303dlh compass

config MPU_SENSORS_MMC314X
    bool "MEMSIC mmc314xMS"
    depends on GYRO_MPU3050_ZTE
    help
      This enables support for the MEMSIC mmc314xMS compass

config MPU_SENSORS_YAS529
    bool "Yamaha yas529"
    depends on GYRO_MPU3050_ZTE
    help
      This enables support for the Yamaha yas529 compass

config MPU_SENSORS_YAS530
    bool "Yamaha yas530"
    depends on GYRO_MPU3050_ZTE
    help
      This enables support for the Yamaha yas530 compass

config MPU_SENSORS_HSCDTD002B
    bool "Alps hscdtd002b"
    depends on GYRO_MPU3050_ZTE
    help
      This enables support for the Alps hscdtd002b compass

config MPU_SENSORS_HSCDTD004A
    bool "Alps hscdtd004a"
    depends on GYRO_MPU3050_ZTE
    help
      This enables support for the Alps hscdtd004a compass

endchoice

choice
    prompt "Pressure Type"
    depends on MPU_SENSORS_MPU6000 || GYRO_MPU3050_ZTE
    default MPU_SENSORS_BMA085

config MPU_SENSORS_PRESSURE_NONE
    bool "NONE"
    depends on MPU_SENSORS_MPU6000 || GYRO_MPU3050_ZTE
    help
      This disables pressure sensor support for the MPU6000

config MPU_SENSORS_BMA085
    bool "Bosch BMA085"
    depends on MPU_SENSORS_MPU6000 || GYRO_MPU3050_ZTE
    help
      This enables support for the Bosch bma085 pressure sensor

endchoice

config MPU_SENSORS_TIMERIRQ
    tristate "Timer IRQ"
    help
      If you say yes here you get access to the timerirq device handle which
      can be used to select on.  This can be used instead of IRQ's, sleeping,
      or timer threads.  Reading from this device returns the same type of
      information as reading from the MPU and slave IRQ's.

endmenu
## ZTE_MODIFY end ##
```

## drivers/net/wireless/bcm4329_zte/Kconfig
```kconfig
config WIFI_BCM4329_ZTE
	bool "Broadcom 4329 zte wireless"
	default n
	
config BCM4329_ZTE
	tristate "Broadcom 4329 zte wireless cards support"
	depends on MMC && WIFI_BCM4329_ZTE
	default m
	select WIRELESS_EXT
	select WEXT_PRIV
	---help---
	  This module adds support for wireless adapters based on
	  Broadcom 4329 chipset.

	  This driver uses the kernel's wireless extensions subsystem.

	  If you choose to build a module, it'll be called dhd. Say M if
	  unsure.

config BCM4329_FW_PATH
	depends on BCM4329_ZTE
	string "Firmware path"
	default "/system/etc/firmware/fw_bcm4329.bin"
	---help---
	  Path to the firmware file.

config BCM4329_NVRAM_PATH
	depends on BCM4329_ZTE
	string "NVRAM path"
	default "/proc/calibration"
	---help---
	  Path to the calibration file.
```

## drivers/net/wireless/bcm4330_b1_b2_zte/Kconfig
```kconfig
config WIFI_BCM4330_ZTE
	bool "Broadcom bcm4330 b1&b2 zte wireless"
	default n
	
config BCM4330_ZTE
	default n
	tristate "Broadcom bcm4330 b1&b2 zte wireless cards support"
	depends on MMC && WIFI_BCM4330_ZTE
	select WIRELESS_EXT
	select WEXT_PRIV
	---help---
	  This module adds support for wireless adapters based on
	  Broadcom chipset.

	  This driver uses the kernel's wireless extensions subsystem.

	  If you choose to build a module, it'll be called dhd. Say M if
	  unsure.
	  
	  
```

## drivers/net/wireless/bcm4330_zte/Kconfig
```kconfig
config WIFI_BCM4330_ZTE
	bool "Broadcom 4330 zte wireless"
	default n
	
config BCM4330_ZTE
	default n
	tristate "Broadcom 4330 wireless cards support"
	depends on MMC && WIFI_BCM4330_ZTE
	select WIRELESS_EXT
	select WEXT_PRIV
	---help---
	  This module adds support for wireless adapters based on
	  Broadcom 4330 chipset.

	  This driver uses the kernel's wireless extensions subsystem.

	  If you choose to build a module, it'll be called dhd. Say M if
	  unsure.
	  
	  
```
